## arch/powerpc/Kconfig.rej
```kconfig
--- arch/powerpc/Kconfig
+++ arch/powerpc/Kconfig
@@ -138,6 +138,7 @@ config PPC
 	select ARCH_USE_BUILTIN_BSWAP
 	select OLD_SIGSUSPEND
 	select OLD_SIGACTION if PPC32
+	select ARCH_SUPPORTS_ATOMIC_RMW
 
 config EARLY_PRINTK
 	bool
```

## arch/sparc/Kconfig.rej
```kconfig
--- arch/sparc/Kconfig
+++ arch/sparc/Kconfig
@@ -77,6 +77,7 @@ config SPARC64
 	select ARCH_HAVE_NMI_SAFE_CMPXCHG
 	select HAVE_C_RECORDMCOUNT
 	select NO_BOOTMEM
+	select ARCH_SUPPORTS_ATOMIC_RMW
 
 config ARCH_DEFCONFIG
 	string
```

## arch/x86/Kconfig.rej
```kconfig
--- arch/x86/Kconfig
+++ arch/x86/Kconfig
@@ -121,6 +121,7 @@ config X86
 	select OLD_SIGACTION if X86_32
 	select COMPAT_OLD_SIGACTION if IA32_EMULATION
 	select RTC_LIB
+	select ARCH_SUPPORTS_ATOMIC_RMW
 
 config INSTRUCTION_DECODER
 	def_bool y
```

## drivers/soc/qcom/Kconfig.rej
```kconfig
--- drivers/soc/qcom/Kconfig
+++ drivers/soc/qcom/Kconfig
@@ -588,10 +588,14 @@ source "drivers/soc/qcom/memshare/Kconfig"
 config BOOTINFO
 	bool "Boot Information Feature"
 	default n
+
+config FORCE_FAST_CHARGE
+	bool "Force faster charge rate for AC/USB"
+	default y
 	help
-	  This feature provides access to certain boot information
-	  from both kernel context (via function call) and user
-	  context (via /proc/bootinfo).
+	  This allows users to override default charge rate for both USB and AC
+	  charger input current
+
 
 config MMI_SOC_INFO
 	default n
```

## kernel/Kconfig.locks.rej
```kconfig
--- kernel/Kconfig.locks
+++ kernel/Kconfig.locks
@@ -220,6 +220,9 @@ config INLINE_WRITE_UNLOCK_IRQRESTORE
 
 endif
 
+config ARCH_SUPPORTS_ATOMIC_RMW
+	bool
+
 config MUTEX_SPIN_ON_OWNER
 	def_bool y
-	depends on SMP && !DEBUG_MUTEXES
+	depends on SMP && !DEBUG_MUTEXES && ARCH_SUPPORTS_ATOMIC_RMW
```
